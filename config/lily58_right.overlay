/*
 * Encoders: the stock lily58 shield only defines left_encoder.
 * Both halves must share the same sensor list so that sensor-bindings
 * indexes match: index 0 = left encoder, index 1 = right encoder.
 */

/ {
    right_encoder: encoder_right {
        compatible = "alps,ec11";
        // Lily58 PCB is reversible: the right half uses the same pins as the left one.
        a-gpios = <&pro_micro 21 (GPIO_ACTIVE_HIGH | GPIO_PULL_UP)>;
        b-gpios = <&pro_micro 20 (GPIO_ACTIVE_HIGH | GPIO_PULL_UP)>;
        steps = <80>;
        status = "disabled";
    };
};

&sensors {
    sensors = <&left_encoder &right_encoder>;
};

&right_encoder {
    status = "okay";
};

// The stock shield leaves left_encoder enabled on both halves; on the right
// half it would sit on the same pins as right_encoder.
&left_encoder {
    status = "disabled";
};
