/*
 * Encoders: the stock lily58 shield only defines left_encoder.
 * Both halves must share the same sensor list so that sensor-bindings
 * indexes match: index 0 = left encoder, index 1 = right encoder.
 */

/ {
    right_encoder: encoder_right {
        compatible = "alps,ec11";
        // Lily58 PCB is reversible: the right half uses the same pins as the left one.
        a-gpios = <&pro_micro 21 (GPIO_ACTIVE_HIGH | GPIO_PULL_UP)>;
        b-gpios = <&pro_micro 20 (GPIO_ACTIVE_HIGH | GPIO_PULL_UP)>;
        steps = <80>;
        status = "disabled";
    };
};

&sensors {
    sensors = <&left_encoder &right_encoder>;
};

// No encoder is fitted on the left half. The stock shield enables left_encoder,
// and polling its unconnected pins produced phantom sensor events that kept the
// keyboard "active", so the left display never blanked.
&left_encoder {
    status = "disabled";
};
